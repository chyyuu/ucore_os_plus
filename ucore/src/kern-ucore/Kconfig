## ucore/src/kern-ucore/Kconfig
```kconfig
menu "Toolchain setup"

config CROSS_COMPILE
  string "Cross-compiler tool prefix"

config ADDITIONAL_CFLAGS
  string "Additional CFLAGS"

config ADDITIONAL_LDFLAGS
  string "Additional LDFLAGS"

endmenu
```

## ucore/src/kern-ucore/arch/amd64/Kconfig
```kconfig
source src/kern-ucore/Kconfig
source src/kern-ucore/numa/Kconfig
source src/kern-ucore/mm/Kconfig
source src/kern-ucore/schedule/Kconfig
source src/kern-ucore/fs/Kconfig

menu "Profiler"
config PROFILER_ON
	bool "Enable profiler"
	default n

endmenu
```

## ucore/src/kern-ucore/arch/arm/Kconfig
```kconfig
source src/kern-ucore/Kconfig

menu "Ucore Kernel Configuration (ARM)"

choice
	prompt "ARM CPU version"
	default ARM_CPU_V7
	help
    Select ARM CPU version
	
config ARM_CPU_V5
	bool "ARMv5"

config ARM_CPU_V6
	bool "ARMv6"

config ARM_CPU_V7
	bool "ARMv7"

endchoice

choice
  prompt "Board"
  default ARM_BOARD_GOLDFISH

config ARM_BOARD_GOLDFISH
  bool "Goldfish"

config ARM_BOARD_VERSATILEPB
  bool "Versatilepb"

config ARM_BOARD_AT91
  bool "AT91SAM"

config ARM_BOARD_PANDABOARD
  bool "Pandaboard ES rev2"

config ARM_BOARD_RASPBERRYPI
  bool "Raspberry Pi"

endchoice

config HAVE_RAMDISK
  bool "Enable Ramdisk"
  default y

config RAMDISK_FILE
  depends HAVE_RAMDISK
  string "Ramdisk File"
  default "sfs.img"
  help
    Path to the ramdisk which will be built into the kernel image. Both absolute
    and relative paths are acceptable..Relative paths are considered to be from
    the building directory.


config DRAM_START
  hex "DRAM start address"
  default 0x0

config DRAM_SIZE
  hex "DRAM size(Byte) "
  default 0x1000000

config HAVE_BOOTLOADER
  bool "Use uCore bootloader"
  default n

config FPU_ENABLE
  bool "Enable FPU"
  default n

config BIONIC_LIBC
  depends FPU_ENABLE
  bool "Support Bionic Libc"
  default n

config BOOTLOADER_START_ADDR
  depends HAVE_BOOTLOADER
  hex "Bootloader start address"
  default 0x0

endmenu

source src/kern-ucore/numa/Kconfig
source src/kern-ucore/mm/Kconfig
source src/kern-ucore/schedule/Kconfig
source src/kern-ucore/fs/Kconfig
source src/kern-ucore/module/Kconfig
source src/kern-ucore/dde36/Kconfig
```

## ucore/src/kern-ucore/dde36/Kconfig
```kconfig
menu "Linux Device Driver Environment 3.6"

config HAVE_LINUX_DDE36_BASE
  bool "Enable DDE base"
  default n

config DDE36_EXAMPLE_CHRDEV
  depends HAVE_LINUX_DDE36_BASE
  bool "Enable Example Chrdev"
  default n

endmenu
```

## ucore/src/kern-ucore/fs/Kconfig
```kconfig
menu Filesystem

config HAVE_SFS
  bool "Enable Simple Filesystem(SFS)"
  default y

config SFS_IMAGE_SIZE
  depends HAVE_SFS
  int  "SFS Image size"
  default 4

config SFS_MINIMAL_CONTENT
  depends HAVE_SFS
  bool "Minimize contents"
  default n
  help
    When selected, this option will exclude most useless files in the
    sfs img to make it fit for embedded systems.

config HAVE_YAFFS2
  bool "Enable YAFFS2"
  default n

config HAVE_YAFFS2_RAMDISK
  depends HAVE_YAFFS2
  bool "Enable YAFFS2 Ramdisk (for debugging)"
  default n

config HAVE_FATFS
  bool "Enable Fat32"
  default n

endmenu
```

## ucore/src/kern-ucore/mm/Kconfig
```kconfig
menu "Memory Management"

config SWAP
	bool "Support for paging of anonymous memory (swap)"
	default y
	help
		Enable support for providing more virtual memory than actual RAM
		present by using disk storage.

endmenu
```

## ucore/src/kern-ucore/module/Kconfig
```kconfig
menu "Linux Device Driver Environment"

config HAVE_LINUX_DDE_BASE
	bool "Enable Linux DDE base"
	default y
	help
		Enable Linux DDE base

#config DDE_BLOCK_SUPPORT
#  bool "Enable Linux Block"
#  default n

config DDE_GOLDFISH_FB
  depends ARM_BOARD_GOLDFISH
  depends HAVE_LINUX_DDE_BASE
  bool "Enable Goldfish Framebuffer"
  default n

config DDE_GOLDFISH_EVENT
  depends ARM_BOARD_GOLDFISH
  depends HAVE_LINUX_DDE_BASE
  bool "Enable Goldfish Event Input"
  default n


config DDE_EXAMPLE_CHRDEV
  depends HAVE_LINUX_DDE_BASE
  bool "Enable Example Chrdev"
  default n

config DDE_MMC_SUPPORT
  depends HAVE_LINUX_DDE_BASE
  bool "Enable MMC Card"
  default n

config DDE_MMC_HAVE_SDIO
  depends DDE_MMC_SUPPORT
  bool "Enable SDIO support"
  default n

config DDE_GOLDFISH_MMC
  depends ARM_BOARD_GOLDFISH
  depends DDE_MMC_SUPPORT
  bool "Enable Goldfish MMC Host"
  default n

config DDE_PANDABOARD_MMC
  depends ARM_BOARD_PANDABOARD
  depends DDE_MMC_SUPPORT
  bool "Enable Pandaboard MMC_HS Host"
  default n

config DDE_MMC_TEST
  depends DDE_MMC_SUPPORT
  bool "Enable MMC test driver"
  default n

config DDE_MMC_UCORE_BLOCK
  depends DDE_MMC_SUPPORT
  bool "Enable MMC block driver (Ucore)"
  default n

endmenu
```

## ucore/src/kern-ucore/numa/Kconfig
```kconfig
menu "NUMA Support"

config NR_CPUS
  int  "Maximum number of CPUs supported"
  default 1

config NR_NUMA_NODES
  int "Maximum number of NUMA nodes supported"
  default 1

config NR_MEMS_PER_NODE
  int "Maximum number of continuous memory regions supported in a NUMA node"
  default 1

config ENABLE_IPI
  bool "Enable IPI"
  default n
endmenu
```

## ucore/src/kern-ucore/schedule/Kconfig
```kconfig
menu Schedule

choice
  prompt "Scheduler"
  default SCHEDULER_MLFQ 

config SCHEDULER_RR
  bool "Round-Robin"

config SCHEDULER_MLFQ
  bool "MLFQ"

config SCHEDULER_MPRR
  bool "MPRR"
endchoice

endmenu
```
